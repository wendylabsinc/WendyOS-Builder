## meta-tegra-extensions-jp6/conf/layer.conf
```bitbake
BBPATH:prepend := "${LAYERDIR}:"

BBFILES += " \
    ${LAYERDIR}/recipes-*/*/*.bb \
    ${LAYERDIR}/recipes-*/*/*.bbappend \
    "

BBFILE_COLLECTIONS += "wendyos-tegra-jp6"
BBFILE_PATTERN_wendyos-tegra-jp6 := "^${LAYERDIR}/"
BBFILE_PRIORITY_wendyos-tegra-jp6 = "52"

LAYERSERIES_COMPAT_wendyos-tegra-jp6 = "scarthgap"
LAYERVERSION_wendyos-tegra-jp6 = "1"
LAYERDEPENDS_wendyos-tegra-jp6 = "core wendyos wendyos-tegra"

BBFILE_PATTERN_IGNORE_EMPTY_wendyos-tegra-jp6 = "1"
```

## meta-tegra-extensions-jp7/conf/layer.conf
```bitbake
BBPATH:prepend := "${LAYERDIR}:"

BBFILES += " \
    ${LAYERDIR}/recipes-*/*/*.bb \
    ${LAYERDIR}/recipes-*/*/*.bbappend \
    "

BBFILE_COLLECTIONS += "wendyos-tegra-jp7"
BBFILE_PATTERN_wendyos-tegra-jp7 := "^${LAYERDIR}/"
BBFILE_PRIORITY_wendyos-tegra-jp7 = "52"

LAYERSERIES_COMPAT_wendyos-tegra-jp7 = "wrynose blacksail"
LAYERVERSION_wendyos-tegra-jp7 = "1"
LAYERDEPENDS_wendyos-tegra-jp7 = "core wendyos wendyos-tegra"

# This layer carries only bbappends and their files dirs; no .bb recipes.
# Suppress the empty-collection warning.
BBFILE_PATTERN_IGNORE_EMPTY_wendyos-tegra-jp7 = "1"
```

## meta-x86-extensions/files/wic/genericx86-ab.wks
```
# WendyOS x86 A/B layout for the wendyos-update OTA stack.
#
# Device-agnostic GPT. Nothing here pins a runtime device: --ondisk names the
# disk only while wic assembles the raw image, and the resulting .wic is written
# unchanged to whatever the target boots from (NVMe, SATA/eMMC or USB). At runtime
# everything is found by GPT partlabel / fs-label — GRUB does `search --label`, the
# kernel gets root=PARTLABEL=, and the fstab mounts by LABEL. So one image boots
# any of those disks with no per-disk variant.
#
# Partition ORDER is load-bearing and mirrors meta-rpi-extensions/files/wic/
# rpi-wendy-ab.wks:
#   p1 boot    (FAT)  EFI System Partition: GRUB (EFI/BOOT/bootx64.efi + grub.cfg)
#                     + the A/B grubenv. Shared, not per-slot. The kernel is NOT
#                     kept here (install-kernel-into-boot-dir=false) — GRUB loads
#                     it from the selected slot's own /boot instead (A/B-safe).
#   p2 config  (FAT)  first-boot provisioning seed (label "config").
#   p3 rootfsA (ext4) slot 0  ─┐ both slots flashed with the SAME rootfs so the
#   p4 rootfsB (ext4) slot 1  ─┘ device is bootable + recoverable from the factory
#                              and A->B->A is testable immediately.
#   p5 data    (ext4) persistent /data — LAST so it can grow to fill the disk on
#                     first boot.
#
# The A/B trial/rollback logic lives in grubAB.cfg (copied verbatim to
# EFI/BOOT/grub.cfg by the bootimg_efi plugin via `bootloader --configfile`).
# rootfsA/rootfsB are --fixed-size so the OTA agent raw-writes a full rootfs image
# into a slot without repartitioning: image == slot == .wendy payload, one pinned
# constant (WENDYOS_ROOTFS_SIZE_KB in conf/distro/include/wendyos-rootfs-size.inc).
# Do NOT add expand-rootfs: it would grow rootfsA over rootfsB. The /data grow is
# a separate first-boot step.
bootloader --ptable gpt --configfile="grubAB.cfg" --timeout=3
part /boot --source bootimg_efi --sourceparams="loader=grub-efi,install-kernel-into-boot-dir=false" --ondisk sda --fstype=vfat --label boot --active --align 1024 --size 128M
part --ondisk sda --fstype=vfat --label config --align 1024 --size 256M
part --source rootfs --ondisk sda --fstype=ext4 --label rootfsA --align 1024 --fixed-size ${WENDYOS_ROOTFS_SIZE_KB}K
part --source rootfs --ondisk sda --fstype=ext4 --label rootfsB --align 1024 --fixed-size ${WENDYOS_ROOTFS_SIZE_KB}K
part --ondisk sda --fstype=ext4 --label data --align 1024 --size 512M
```

## wic/rpi-mbr.wks
```
# RPi3 MBR layout. The BCM2837 GPU bootrom can only read MBR-partitioned
# FAT32 — GPT support landed later in the Pi 4 EEPROM bootloader, so the
# shared rpi-partuuid.wks is not usable on Pi 3.
#
# Partitions are referenced by filesystem label: under MBR the kernel exposes
# PARTUUIDs as <disk-signature>-<partno>, not as UUIDv4, so the values from
# partuuid-rpi.bbclass would never resolve in cmdline.txt or fstab. See
# rpi-cmdline.bbappend and rpi-mbr-fstab for the matching consumers.
bootloader --ptable msdos
part /boot --source bootimg-partition --ondisk mmcblk0 --fstype=vfat --label boot --active --align 4096 --size 128M
part --ondisk mmcblk0 --fstype=vfat --label config --align 4096 --size ${WENDYOS_CONFIG_PART_SIZE_MB}M
part / --source rootfs --ondisk mmcblk0 --fstype=ext4 --label root --align 4096 --size 8192M
```
