## meta-rpi-extensions/conf/layer.conf
```bitbake
BBPATH:prepend := "${LAYERDIR}:"

BBFILES += " \
    ${LAYERDIR}/recipes-*/*/*.bb \
    ${LAYERDIR}/recipes-*/*/*.bbappend \
    "

BBFILE_COLLECTIONS += "wendyos-rpi"
BBFILE_PATTERN_wendyos-rpi := "^${LAYERDIR}/"
BBFILE_PRIORITY_wendyos-rpi = "51"

# Every RPi board (rpi3, rpi4, rpi5) builds on blacksail.
LAYERSERIES_COMPAT_wendyos-rpi = "blacksail"
LAYERVERSION_wendyos-rpi = "1"
LAYERDEPENDS_wendyos-rpi = "core wendyos"
```
