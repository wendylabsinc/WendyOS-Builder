## conf/machine/raspberrypi3-64-wendyos.conf
```bitbake
MACHINEOVERRIDES =. "rpi:raspberrypi3-64:"
require conf/machine/raspberrypi3-64.conf
require conf/machine/include/raspberrypi-common-wendyos.inc

# --- wendyos-update A/B OTA stack -------------------------------------------
# Unlike RPi4/5 (GPT), the BCM2837 GPU bootrom can only boot an MBR card, so the
# A/B layout is the MBR variant rpi-wendy-ab-mbr.wks (boot=p1, rootfsA=p2,
# rootfsB=p3 primary; config/data logical p5/p6). The matching slot->partition
# map (WENDYOS_ROOTFS_PART_A/B=2/3) and MBR fstab (rpi-wendy-mbr-fstab, /boot by
# LABEL) are selected by the :raspberrypi3-64 overrides in rpi-u-boot-scr.bbappend
# and rpi-base-files.inc. rpi3 (BCM2837) gets NO rc4 U-Boot bump (raspberrypi5-
# scoped) — it uses stock blacksail U-Boot. The A/B layout is built via wic
# (ext4 added by wendyos-image.bb, .wendy by wendyos-update.inc).
WKS_FILE = "rpi-wendy-ab-mbr.wks"
IMAGE_FSTYPES:append = " wic"

# RPi3 B/B+ cannot do USB gadget (LAN9514 hub blocks DWC2 peripheral mode).
# RPi3 A+ technically can, but requires non-standard cable + external power,
# so the default stays off.
WENDYOS_USB_GADGET ?= "0"

# RPi3 boot config (consumed by rpi-config_%.bbappend). ORDER MATTERS — the
# firmware processes these top-to-bottom and a later camera overlay overrides
# the single bcm2835 unicam CSI endpoint set by an earlier one:
# - dtoverlay=imx477 (FIRST): explicitly load the IMX477 sensor overlay. UNLIKE
#   the Pi 5 (whose RP1 detects this ribbon), the Pi 3 VideoCore firmware does
#   NOT recognise it via camera_auto_detect (same root cause confirmed on a
#   Pi 4, including a cold boot), so without an explicit overlay the sensor
#   never probes and libcamera enumerates zero cameras (WDY-1603).
# - camera_auto_detect=1 (LAST): lets an auto-detectable module (e.g. an
#   official IMX219 Camera Module) override the imx477 endpoint above so the
#   same image supports both sensors; the orphaned imx477 node then just fails
#   to probe. It is a no-op for the non-detectable IMX477 ribbon, which the
#   explicit overlay already covers. NOTE: a *non-detectable* third-party IMX219
#   ribbon would not be picked up here and would need a first-boot i2c probe.
#   Pairs with the libcamera stack (libcamera + libcamerasrc + the rpi/vc4
#   pipeline) from packagegroup-wendyos-rpi and the meta-rpi-extensions libcamera
#   bbappend. Pi3 has no PCIe, so unlike the Pi 5 conf there is no dtparam=pciex1.
RPI_EXTRA_CONFIG = "dtoverlay=imx477\ncamera_auto_detect=1\n"

# Mini UART on GPIO 14/15 (upstream default for RPi3): Bluetooth keeps the
# PL011 (ttyAMA0), serial console runs on ttyS0. Mini-UART baud rate is
# derived from the VPU clock and can drift under heavy CPU load, so serial
# output may occasionally garble — acceptable trade-off for onboard BT.
SERIAL_CONSOLES = "115200;ttyS0"

# No usb0 interface on RPi3 — leave WENDYOS_MDNS_INTERFACES empty so mDNS
# advertises on all interfaces (WiFi/Ethernet).
MACHINE_FEATURES:append = " wifi bluetooth"

# Stable board identity written to /etc/wendyos/device-type
WENDYOS_BOARD_ID = "raspberry-pi-3"
```

## conf/machine/raspberrypi4-64-wendyos.conf
```bitbake
MACHINEOVERRIDES =. "rpi:raspberrypi4-64:"
require conf/machine/raspberrypi4-64.conf
require conf/machine/include/raspberrypi-common-wendyos.inc

# --- wendyos-update A/B OTA stack -------------------------------------------
# rpi4 (BCM2711) gets NO rc4 U-Boot bump — that's raspberrypi5-scoped — so it
# uses stock blacksail U-Boot. The A/B layout is built via wic (ext4 added by
# wendyos-image.bb, .wendy by wendyos-update.inc). The wendy A/B wks is GPT;
# recent Pi4 EEPROM supports GPT-boot -- CONFIRM on HW.
WKS_FILE = "rpi-wendy-ab.wks"
IMAGE_FSTYPES:append = " wic"

# RPi4 has an OTG-capable USB-C port — enable gadget by default.
WENDYOS_USB_GADGET ?= "1"

# RPi4 boot config (consumed by rpi-config_%.bbappend). ORDER MATTERS — the
# firmware processes these top-to-bottom and a later camera overlay overrides
# the single bcm2835 unicam CSI endpoint set by an earlier one:
# - dtoverlay=imx477 (FIRST): explicitly load the IMX477 sensor overlay. UNLIKE
#   the Pi 5 (whose RP1 detects this ribbon), the Pi 4 VideoCore firmware does
#   NOT recognise it via camera_auto_detect — confirmed on a Pi 4, including a
#   cold boot — so without an explicit overlay the sensor never probes and
#   libcamera enumerates zero cameras (WDY-1603).
# - camera_auto_detect=1 (LAST): lets an auto-detectable module (e.g. an
#   official IMX219 Camera Module) override the imx477 endpoint above so the
#   same image supports both sensors; the orphaned imx477 node then just fails
#   to probe. It is a no-op for the non-detectable IMX477 ribbon, which the
#   explicit overlay already covers. NOTE: a *non-detectable* third-party IMX219
#   ribbon would not be picked up here and would need a first-boot i2c probe.
#   Pairs with the libcamera stack (libcamera + libcamerasrc + the rpi/vc4
#   pipeline) from packagegroup-wendyos-rpi and the meta-rpi-extensions libcamera
#   bbappend. Pi4 has no PCIe, so unlike the Pi 5 conf there is no dtparam=pciex1.
RPI_EXTRA_CONFIG = "dtoverlay=imx477\ncamera_auto_detect=1\n"

# Mini UART on GPIO 14/15 (upstream default for RPi4): Bluetooth keeps the
# PL011 (ttyAMA0), serial console runs on ttyS0. Mini-UART baud rate is
# derived from the VPU clock and can drift under heavy CPU load, so serial
# output may occasionally garble — acceptable trade-off for onboard BT.
SERIAL_CONSOLES = "115200;ttyS0"

MACHINE_FEATURES:append = " wifi bluetooth usbgadget"

# Stable board identity written to /etc/wendyos/device-type
WENDYOS_BOARD_ID = "raspberry-pi-4"
```

## conf/machine/raspberrypi5-nvme-wendyos.conf
```bitbake
MACHINEOVERRIDES =. "rpi:raspberrypi5-nvme:raspberrypi5:"
require conf/machine/raspberrypi5-wendyos.conf

# wendyos-update A/B OTA: inherits WENDYOS_OTA="wendy" + IMAGE_FSTYPES wic from
# the parent; just point WKS_FILE at the NVMe-ondisk A/B layout. The matching
# U-Boot boot-script overrides (nvme load interface + `nvme scan`) are keyed on
# :raspberrypi5-nvme in rpi-u-boot-scr.bbappend.
WKS_FILE = "rpi-wendy-ab-nvme.wks"

# dtparam=pciex1 is inherited from raspberrypi5-wendyos.conf (set there
# so the SD image can also access the NVMe for SSH-based flashing
# workflows). Uncomment to override independently if needed.
#RPI_EXTRA_CONFIG = "dtparam=pciex1\n"

# Stable board identity written to /etc/wendyos/device-type
WENDYOS_BOARD_ID = "raspberry-pi-5"
```

## conf/machine/raspberrypi5-wendyos.conf
```bitbake
MACHINEOVERRIDES =. "rpi:raspberrypi5:"
require conf/machine/raspberrypi5.conf
require conf/machine/include/raspberrypi-common-wendyos.inc

# --- wendyos-update A/B OTA stack (replaces Mender on RPi5) ----------------
# Set AFTER the common include (which defaults WENDYOS_OTA="mender" for the
# RPi3/4/5 family) so RPi5 moves to the wendy stack while RPi3/4 stay on
# Mender. The rpi5-sd/rpi5-nvme board templates drop the Mender layers from
# BBLAYERS (bblayers/rpi-wendy.inc); the rest of the wendy wiring keys off
# WENDYOS_OTA == "wendy" (wendyos.conf requires wendyos-update.inc; the RPi
# fstab/cmdline/boot-script/data bits gate on it too).
WENDYOS_OTA = "wendy"

# No Mender -> nothing generates the sdimg; build our hand-authored A/B layout
# via wic. IMAGE_FSTYPES gains the flashable wic (.wendy is added for the
# product image by wendyos-update.inc; ext4 by wendyos-image.bb for packing).
WKS_FILE = "rpi-wendy-ab.wks"
IMAGE_FSTYPES:append = " wic"

# RPi5 has a dedicated USB-C peripheral controller (BCM2712 dwc2 at
# /sys/class/udc/1000480000.usb, separate from the RP1 xHCI host ports
# on USB-A). Enable gadget by default. See
# meta-rpi-extensions/recipes-bsp/bootfiles/rpi-cmdline.bbappend and
# the BCM2712 g_dma=false kernel patch for the full RPi5 gadget story.
WENDYOS_USB_GADGET ?= "1"

# RPi5 boot config (consumed by rpi-config_%.bbappend):
# - dtparam=pciex1: enable the PCIe x1 lane in the kernel device tree.
#   Required for the kernel to access the NVMe drive (e.g. when booting
#   from SD and flashing the NVMe over SSH, or any data-only NVMe use).
# - camera_auto_detect=1: probe an official CSI camera (IMX219/IMX477/
#   IMX708) on either CAM connector at boot, mirroring stock Raspberry Pi
#   OS. The sensor overlay is loaded from the camera's on-board EEPROM, so
#   no hardcoded dtoverlay is needed. A ribbon without an EEPROM instead
#   needs an explicit overlay, e.g. append "dtoverlay=imx477,cam1\n".
#   Pairs with the libcamera stack (libcamera + libcamerasrc + the PiSP
#   pipeline) pulled in by packagegroup-wendyos-rpi and the
#   meta-rpi-extensions libcamera bbappend.
RPI_EXTRA_CONFIG = "dtparam=pciex1\ncamera_auto_detect=1\n"

# PL011 is mapped to GPIO 14/15 via dtoverlay=uart0 (see
# meta-rpi-extensions/recipes-bsp/bootfiles/rpi-config_%.bbappend) so the
# serial console lands on ttyAMA0, not the mini UART.
SERIAL_CONSOLES = "115200;ttyAMA0"

MACHINE_FEATURES:append = " wifi bluetooth usbgadget"

# Stable board identity written to /etc/wendyos/device-type
WENDYOS_BOARD_ID = "raspberry-pi-5"
```

## meta-rpi-extensions/files/wic/rpi-wendy-ab-mbr.wks
```
# WendyOS A/B layout for the wendyos-update OTA stack (WENDYOS_OTA = "wendy"),
# MBR variant for Raspberry Pi 3. The BCM2837 GPU bootrom can only read an
# MBR-partitioned FAT32 boot partition — GPT support landed later in the Pi 4
# EEPROM bootloader — so the GPT rpi-wendy-ab.wks is not usable on a Pi 3.
#
# MBR has only 4 primary slots, and an A/B image needs 5 partitions, so wic
# auto-creates an extended partition (p4) and places the overflow as logical
# partitions from p5 (see oe-core wic direct.py). The resulting geometry mirrors
# the proven RPi3 A/B layout exactly:
#
#   p1 boot    (FAT,  primary)  RPi firmware + u-boot.bin + boot.scr + config.txt
#                               + cmdline.txt + uboot.env (the U-Boot environment).
#   p2 rootfsA (ext4, primary)  slot 0  ─┐ both slots flashed with the SAME rootfs
#   p3 rootfsB (ext4, primary)  slot 1  ─┘ so the device is bootable + recoverable
#                                          from the factory and A->B->A is testable
#                                          immediately.
#   p4 (extended container, auto-created by wic)
#   p5 config  (FAT,  logical)  first-boot provisioning seed (label "config").
#   p6 data    (ext4, logical)  persistent /data — LAST so it can grow to fill the
#                               card on first boot.
#
# Partition ORDER is load-bearing and is duplicated in two places that MUST stay
# in sync with it:
#   - the boot script's slot->partition map (rpi-u-boot-scr.bbappend, via
#     WENDYOS_ROOTFS_PART_A/B = 2/3 for :raspberrypi3-64 — NOT the GPT 3/4), and
#   - the ubootenv connector resolves slots by the label rootfsA/rootfsB. Under
#     MBR there are no GPT partlabels, so it falls back to the ext4 FILESYSTEM
#     label `--label` writes below (wendyos-update commit eb136e93).
#
# Everything is referenced by LABEL, never PARTUUID/--uuid: under MBR the kernel
# exposes PARTUUIDs as <disk-signature>-<partno> (not the UUIDv4 partuuid-rpi
# generates), and wic rejects --uuid on msdos. The matching fstab is
# rpi-wendy-mbr-fstab (LABEL=boot for /boot, vs PARTUUID in the GPT fstab).
#
# Notes (see docs/plans/wendyos-update-rpi.md):
#   - The kernel is loaded by boot.scr from the SELECTED slot's rootfs /boot
#     (A/B-safe), so the rootfs must contain /boot/${KERNEL_IMAGETYPE}.
#   - /data is created as a small ext4 here; the first-boot grow is done by
#     grow-data-part (wendyos-data-setup's format-trigger does NOT fire on a
#     wic-preformatted fs). Do NOT add expand-rootfs to an A/B image: it would
#     grow rootfsA over rootfsB.
#   - Two 8192M rootfs slots + boot + config + data need a >=18 GB card; size
#     the slots down here if the rpi3 fleet uses smaller media.
bootloader --ptable msdos
part /boot   --source bootimg-partition --ondisk mmcblk0 --fstype=vfat --label boot    --active --align 4096 --size 128M
part         --source rootfs            --ondisk mmcblk0 --fstype=ext4 --label rootfsA  --align 4096 --fixed-size ${WENDYOS_ROOTFS_SIZE_KB}K
part         --source rootfs            --ondisk mmcblk0 --fstype=ext4 --label rootfsB  --align 4096 --fixed-size ${WENDYOS_ROOTFS_SIZE_KB}K
part         --ondisk mmcblk0 --fstype=vfat --label config --align 4096 --size ${WENDYOS_CONFIG_PART_SIZE_MB}M
part         --ondisk mmcblk0 --fstype=ext4 --label data   --align 4096 --size 512M
```

## meta-rpi-extensions/files/wic/rpi-wendy-ab-nvme.wks
```
# WendyOS A/B layout for RPi5 NVMe boot, wendyos-update OTA stack.
# Identical to rpi-wendy-ab.wks but ondisk=nvme0n1. See that file for the full
# layout rationale and the must-stay-in-sync notes. The matching boot script
# overrides (nvme load interface + `nvme scan`, /dev/nvme0n1p root base) live
# in rpi-u-boot-scr.bbappend keyed on :raspberrypi5-nvme.
#
#   p1 boot    (FAT)   p2 config (FAT)
#   p3 rootfsA (ext4)  p4 rootfsB (ext4)   p5 data (ext4, grows last)
bootloader --ptable gpt
part /boot   --source bootimg-partition --ondisk nvme0n1 --fstype=vfat --label boot    --active --align 4096 --size 128M --uuid "${WENDYOS_BOOT_PARTUUID}"
part         --ondisk nvme0n1 --fstype=vfat --label config  --align 4096 --size ${WENDYOS_CONFIG_PART_SIZE_MB}M --uuid "${WENDYOS_CONFIG_PARTUUID}"
part         --source rootfs  --ondisk nvme0n1 --fstype=ext4 --label rootfsA --align 4096 --fixed-size ${WENDYOS_ROOTFS_SIZE_KB}K --uuid "${WENDYOS_ROOT_PARTUUID}"
part         --source rootfs  --ondisk nvme0n1 --fstype=ext4 --label rootfsB --align 4096 --fixed-size ${WENDYOS_ROOTFS_SIZE_KB}K
part         --ondisk nvme0n1 --fstype=ext4 --label data    --align 4096 --size 512M
```
