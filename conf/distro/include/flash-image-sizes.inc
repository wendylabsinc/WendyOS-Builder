## conf/distro/include/wendyos-rootfs-size.inc
```bitbake
# Fixed rootfs image size — the single source of truth for the wendy OTA
# stack. Required from wendyos-update.inc,
# so it applies exactly where the .wendy artifact is produced
# (WENDYOS_OTA == "wendy": Thor, RPi3/4/5, Orin).
#
# The rootfs ext4, the on-disk A/B slot, and the .wendy OTA payload must all
# be EXACTLY this size on every build — nightly and release artifacts are
# byte-identical in size by construction, and an image can never outgrow the
# slot it is written to (the on-device slot is fixed at flash time and never
# re-partitioned; wendyos-update raw-writes the payload into it). The
# partition layouts are pinned to the same values: all Jetson (Orin + Thor)
# via ROOTFSPART_SIZE_DEFAULT in tegra-t234.inc / tegra-t264.inc (24 GiB ->
# redundant //2 -> 12 GiB per slot), RPi via the rootfsA/B --fixed-size in
# rpi-wendy-ab*.wks. wendyos-update also refuses payloads larger than the
# target slot as a last line of defense (blockdev capacity pre-check).
#
# Mechanism (oe-core image.bbclass get_rootfs_size, all units KiB):
#   floor    IMAGE_ROOTFS_SIZE      content below this builds to exactly it
#   ceiling  IMAGE_ROOTFS_MAXSIZE   content above this FAILS the build
# With floor == ceiling the size is pinned: growth past the limit is a loud
# build failure, never a silently bigger image. EXTRA_SPACE must be 0 — it is
# added AFTER the floor is applied and would push every build past the
# ceiling. The fixed size itself is the free-space headroom.
#
# Values must stay multiples of 128 MiB (131072 KiB): all Jetson align the
# image to full 32768-block ext4 groups for NVIDIA's UEFI ext4 reader (see
# tegra-t234.inc / tegra-t264.inc), and both sizes are then no-op aligned.
WENDYOS_ROOTFS_SIZE_KB = "12582912"
WENDYOS_ROOTFS_SIZE_KB:rpi = "8388608"

# Generic x86 A/B (genericx86-ab.wks): 14 GiB/slot. x86 bakes the NVIDIA compute
# stack (open kmod + proprietary userspace + container toolkit + full
# linux-firmware), so the rootfs is ~12.1 GiB and needs more headroom than both
# the 8 GiB RPi and the 12 GiB Jetson slot — 12 GiB failed the floor==ceiling
# guard. 14 GiB (112 * 128 MiB) leaves ~1.9 GiB of growth room. floor==ceiling
# means the build fails loudly if the rootfs outgrows this — bump it here (keep it
# a multiple of 128 MiB = 131072 KiB) if that happens again. x86 requires this
# include directly from x86-image.inc (Phase 1 is OTA=none, so wendyos-update.inc
# does not pull it in yet).
WENDYOS_ROOTFS_SIZE_KB:x86-wendyos = "14680064"

# Expose it to wic so the RPi A/B slots derive their --fixed-size straight from
# this one constant (rpi-wendy-ab*.wks: `--fixed-size ${WENDYOS_ROOTFS_SIZE_KB}K`
# — wic reads a K suffix as KiB, so slot == the pinned image size exactly, with
# no duplicated magic number to drift). Harmless on Jetson (tegraflash, no wic).
WICVARS:append = " WENDYOS_ROOTFS_SIZE_KB"

# Scoped :pn-wendyos-image — machine-wide sizing breaks tegra-espimage and
# the initramfs images (same scoping as the rest of this stack).
IMAGE_ROOTFS_SIZE:pn-wendyos-image = "${WENDYOS_ROOTFS_SIZE_KB}"
IMAGE_ROOTFS_MAXSIZE:pn-wendyos-image = "${WENDYOS_ROOTFS_SIZE_KB}"
IMAGE_ROOTFS_EXTRA_SPACE:pn-wendyos-image = "0"

# The default 1.3 du multiplier would fail the build at ~77% real occupancy
# for no benefit — the pinned size already provides the headroom.
IMAGE_OVERHEAD_FACTOR:pn-wendyos-image = "1.0"

# Cancel dnf's rootfs headroom on the pinned image. When package management is on
# (x86: WENDYOS_ENABLE_PACKAGE_MANAGEMENT=1 -> dnf in the image), oe-core's
# rootfs_rpm.bbclass does `IMAGE_ROOTFS_EXTRA_SPACE:append = " + 102400"` (100 MiB
# of rpm/dnf working space). That append lands after the "0" above, and any
# non-zero EXTRA_SPACE breaks floor==ceiling (the ext4 must equal the fixed slot,
# so +100 MiB pushes it past the ceiling and fails do_image). The fixed slot
# already carries GiBs of slack, so the extra is redundant — subtract it back to
# net zero. Guarded on dnf, so it is a no-op on RPi/Jetson (no package management,
# so rootfs_rpm never added it). EXTRA_SPACE is evaluated as arithmetic, so
# "0 + 102400 - 102400" = 0.
IMAGE_ROOTFS_EXTRA_SPACE:append:pn-wendyos-image = "${@' - 102400' if bb.utils.contains('PACKAGE_INSTALL', 'dnf', True, False, d) else ''}"
```

## conf/distro/include/wendyos-update.inc
```bitbake
# wendyos-update OTA stack. Required from wendyos.conf when
# WENDYOS_OTA == "wendy".
#
# Pulls in the on-device pieces and the build-side artifact:
#   - wendyos-update:      the OTA client (/usr/bin/wendyos-update + the
#                          boot-verify and auto-commit systemd units).
#   - wendyos-data-setup:  first-boot /data format/grow + the data.mount.
#   - image_types_wendy:   defines the "wendy" IMAGE_FSTYPE that produces
#                          the .wendy OTA artifact via `wendyos-update pack`.

# Pin the rootfs image size so image == A/B slot == .wendy payload and
# nightly == release, byte for byte (see wendyos-rootfs-size.inc).
require conf/distro/include/wendyos-rootfs-size.inc

# Scope to the product image only (:pn-wendyos-image): this inc is
# required at distro scope, so a bare :append would also hit the Tegra
# flashing-helper images (tegra-espimage, the initramfs images), each
# producing a bogus .wendy and pulling the OTA client into the initramfs.
IMAGE_INSTALL:append:pn-wendyos-image = " wendyos-update wendyos-data-setup"

# Build the .wendy OTA artifact alongside the flashable image. :append
# (not +=) so it survives machine overrides that *replace* IMAGE_FSTYPES
# (e.g. Thor's `IMAGE_FSTYPES:tegra = "tegraflash-tar"`), and :pn- so only
# the product image gets it. IMAGE_CLASSES stays global — the class only
# defines the "wendy" type; nothing runs unless "wendy" is in IMAGE_FSTYPES.
IMAGE_CLASSES += "image_types_wendy"
IMAGE_FSTYPES:append:pn-wendyos-image = " wendy"
```

## conf/distro/include/x86-image.inc
```bitbake
# Generic x86_64 PC image configuration.

# A/B rootfs sizing: image == slot == .wendy payload, pinned to one constant
# (WENDYOS_ROOTFS_SIZE_KB:x86-wendyos) via floor==ceiling, so an OTA image can
# never outgrow its fixed on-device slot. The matching --fixed-size rootfsA/
# rootfsB slots are in meta-x86-extensions/files/wic/genericx86-ab.wks. On the
# OTA path (Phase 2) wendyos-update.inc requires this same file, so requiring it
# here too is idempotent (the only overlap, a WICVARS list entry, dedups harmlessly).
require conf/distro/include/wendyos-rootfs-size.inc

# No runtime package management (dnf), matching the rest of the fleet (the distro
# default is off; x86 used to be the only board turning it on). Two reasons:
#   - Immutable A/B: the rootfs slot is raw-overwritten by every OTA, so anything
#     dnf-installed into it is wiped on the next update — dnf-in-image buys nothing
#     on an A/B rootfs. The GPU userspace feed (Phase B) must use a non-dnf path
#     (baked / /data / container) regardless.
#   - Fixed-size pin: shipping dnf makes oe-core's rootfs_rpm add 100 MiB to
#     IMAGE_ROOTFS_EXTRA_SPACE, which breaks the floor==ceiling A/B slot sizing
#     (the ext4 must equal the fixed slot exactly). Off => EXTRA_SPACE = 0.
# sshd stays on — x86 is a dev/PC-class target and ssh is useful for bring-up.
WENDYOS_ENABLE_PACKAGE_MANAGEMENT:x86-wendyos ?= "0"
WENDYOS_SSHD:x86-wendyos ?= "1"

# Useful on commodity PCs and harmless on machines without a given bus/device.
# packagegroup-wendyos-x86 (meta-x86-extensions) carries the NUC network/BT/GPU
# kernel-module coverage as RRECOMMENDS.
#
# kernel-image puts /boot/${KERNEL_IMAGETYPE} (bzImage) INSIDE the rootfs so GRUB
# can load the kernel from the selected A/B slot's own /boot (grubAB.cfg), keeping
# each slot self-contained. The ESP carries only GRUB + grubenv
# (install-kernel-into-boot-dir=false in the wks), never the kernel.
# grub-editenv edits the A/B grubenv (EFI/BOOT/grubenv) from Linux — the analog of
# fw_setenv on RPi. Needed to flip the slot manually in Phase 1, and by the
# wendyos-update grubenv connector in Phase 2.
IMAGE_INSTALL:append = " \
    pciutils \
    linux-firmware \
    ca-certificates \
    packagegroup-wendyos-x86 \
    kernel-image \
    grub-editenv \
    "

# A/B wic build: GPT + ext4 label tooling, and DO NOT let wic write an fstab. The
# stock wic fstab update would bake a single "/" entry, wrong on the other slot;
# the A/B fstab (x86-wendy-fstab, no "/" entry, LABEL mounts) is installed by
# base-files instead. Mirrors rpi-image.inc.
WIC_CREATE_EXTRA_ARGS ?= "--no-fstab-update"
do_image_wic[depends] += " \
    wic-tools:do_populate_sysroot \
    e2fsprogs-native:do_populate_sysroot \
    gptfdisk-native:do_populate_sysroot \
    "

# --- wendyos-update (wendy OTA) image deltas for x86 -----------------------
# All gated on WENDYOS_OTA == "wendy". When set, wendyos.conf auto-requires
# wendyos-update.inc (installs the wendyos-update agent + wendyos-data-setup, and
# builds the .wendy payload) and packagegroup-wendyos-base pulls in
# wendyos-etc-binds (identity persists on /data across A/B slots).
#
# 1) Extra packages for the wendy A/B OTA image, added only when WENDYOS_OTA=="wendy":
#    - wendyos-update-config: pins the OTA connector to grubenv (meta-x86-extensions).
#    - grow-data-part: grows /data to fill the disk on first boot (shared,
#      board-agnostic; the wks makes /data the last partition so it can grow).
WENDYOS_X86_OTA_INSTALL = " \
    wendyos-update-config \
    grow-data-part \
    "
IMAGE_INSTALL:append = "${@' ' + d.getVar('WENDYOS_X86_OTA_INSTALL') if d.getVar('WENDYOS_OTA') == 'wendy' else ''}"

# 2) Drop wendyos-data-setup (pulled by wendyos-update.inc). Its explicit
#    data.mount uses /dev/disk/by-partlabel/data and its data-init would not grow
#    our wic-preformatted ext4 /data anyway. x86 instead relies on the
#    fstab-generated data.mount (LABEL=data, x86-wendy-fstab) — proven mounting in
#    Phase 1 — which also satisfies wendyos-etc-binds' Requires=data.mount, plus
#    grow-data-part above for the first-boot grow. Mirrors rpi-image.inc.
IMAGE_INSTALL:remove = "${@'wendyos-data-setup' if d.getVar('WENDYOS_OTA') == 'wendy' else ''}"

# NVIDIA dGPU compute stack. When WENDYOS_NVIDIA_DGPU=1 this bakes the full
# driver stack into the image: the open kernel modules, the matching proprietary
# userspace, the container toolkit and the wendyos-gpu-cdi detect/CDI helper.
# Baking the proprietary userspace into a shipped image is a licensing question,
# so this is the current path (Phase A). The shipping path (Phase B) keeps the
# kernel modules baked and moves the userspace to a feed installed at first boot
# by the detect service. See docs/plans/x86-support-plan.md.
IMAGE_INSTALL:append = " \
    ${@oe.utils.ifelse(d.getVar('WENDYOS_NVIDIA_DGPU') == '1', 'packagegroup-wendyos-nvidia-graphics', '')} \
    "

# /config and /data mount points. With the A/B layout they are now real
# partitions (FAT config + ext4 data in genericx86-ab.wks) mounted by LABEL from
# the A/B fstab (x86-wendy-fstab), so the rootfs must carry empty mount-point
# directories for the mounts to land on. install -d is idempotent.
create_wendyos_dirs() {
    install -d -m 0755 ${IMAGE_ROOTFS}/config
    install -d -m 0755 ${IMAGE_ROOTFS}/data
}

ROOTFS_POSTPROCESS_COMMAND:append:x86-wendyos = " create_wendyos_dirs;"

# NVIDIA's prebuilt userspace binaries (nvidia-smi, nvidia-modprobe) use the
# x86-64 ABI loader path /lib64/ld-linux-x86-64.so.2, but OE only provides /lib.
# Add a /lib64 -> lib compat symlink so they execute. Gated on the NVIDIA stack
# so non-NVIDIA x86 images are untouched.
create_lib64_compat() {
    [ -e ${IMAGE_ROOTFS}/lib64 ] || ln -sf lib ${IMAGE_ROOTFS}/lib64
}

ROOTFS_POSTPROCESS_COMMAND:append:x86-wendyos = " ${@oe.utils.ifelse(d.getVar('WENDYOS_NVIDIA_DGPU') == '1', 'create_lib64_compat;', '')}"
```

## conf/machine/genericx86-64-wendyos.conf
```bitbake
#@TYPE: Machine
#@NAME: Generic x86_64 WendyOS PC
#@DESCRIPTION: Experimental WendyOS target for generic Intel/AMD x86_64 PCs.

# Reuse the upstream Yocto reference BSP while exposing Wendy-specific
# overrides for distro/image includes.
MACHINEOVERRIDES =. "x86-wendyos:genericx86-64:"
require conf/machine/genericx86-64.conf

# MVP image formats: a directly flashable UEFI/BIOS .wic disk image plus
# tarball output for inspection and SDK workflows. wendyos-image.bb appends
# ext4 globally.
IMAGE_FSTYPES = "wic wic.bmap tar.bz2"

# A/B disk layout (GRUB-EFI + grubenv). The device-agnostic A/B wks (ESP + config
# + rootfsA/rootfsB fixed-size + data) boots from NVMe, SATA/eMMC or USB by label.
# See meta-x86-extensions/files/wic/genericx86-ab.wks + grubAB.cfg and
# docs/plans/x86-ota-plan.md.
WKS_FILE = "genericx86-ab.wks"

# OTA: the wendyos-update A/B stack (Phase 2, docs/plans/x86-ota-plan.md). Setting
# this to "wendy" auto-requires wendyos-update.inc (installs the update agent and
# builds the .wendy payload) and turns on wendyos-etc-binds, which binds
# /data/etc/wendyos over /etc/wendyos so device identity persists on the shared
# /data partition and survives an A/B slot switch. The grubenv connector selected
# via meta-x86-extensions' wendyos-update-config. WENDYOS_OTA is the gate
# (wendyos.conf defaults it to "mender" for any non-qemu/rpi/tegra machine), so it
# must be pinned here — WENDYOS_MENDER is not the selector.
WENDYOS_OTA = "wendy"
WENDYOS_UPDATE_BOOTLOADER = "0"
WENDYOS_EFI_DEBUG = "0"
WENDYOS_DEEPSTREAM = "0"
WENDYOS_USB_GADGET = "0"

# Persistent journal, on by default. With WENDYOS_OTA="wendy" the fleet mechanism
# (systemd-conf) installs var-log.mount, which bind-mounts /data/log -> /var/log
# (Storage=persistent). Because it lands on the shared /data partition, logs
# survive both reboots and A/B slot switches. Same path Tegra uses.
WENDYOS_PERSIST_JOURNAL_LOGS = "1"
WENDYOS_NVIDIA_DGPU ??= "1"

MACHINE_FEATURES:append = " alsa bluetooth usbhost vfat ext2 screen pci"

# Stable board identity written to /etc/wendyos/device-type
WENDYOS_BOARD_ID = "generic-x86-64"

# Show the GRUB boot menu on the attached monitor and keyboard, not only the
# serial port. The OE default emits just a `serial` line with no terminal
# selection, so force terminal_input/output to both console and serial. This
# lets the kernel cmdline be edited from the console (press `e`). The longer
# timeout gives time to catch the menu.
GRUB_OPTS = "serial --unit=0 --speed=115200 --word=8 --parity=no --stop=1;terminal_input console serial;terminal_output console serial"
GRUB_TIMEOUT = "10"
```
