## conf/machine/include/raspberrypi-common-wendyos.inc
```bitbake
# Common WendyOS settings for all 64-bit RPi machines (RPi3/4/5).
# Required after the upstream raspberrypiN-64.conf include in each
# machine conf so machine-specific overrides come last where needed.

# The wendy A/B wks layouts handle the disk image; rpi-sdimg from
# meta-raspberrypi would compete. Tegra/UEFI types don't apply.
IMAGE_FSTYPES:remove = "tegraflash dataimg uefiimg uefiimg.bmap uefiimg.bz2 rpi-sdimg"

LICENSE_FLAGS_ACCEPTED += "synaptics-killswitch"

# All RPi machines run the wendyos-update OTA stack (the wendyos.conf
# default); the A/B disk layout comes from the per-machine rpi-wendy-ab*.wks
# (config partition before /data, /data last so it can grow to fill the
# medium on first boot via grow-data-part). The FAT32 "config" partition is
# seeded by `wendy os install` with first-boot provisioning; wendy-agent
# consumes and erases the seed files (configpartition.Apply) but the
# partition itself persists as a re-seed/recovery channel.

# U-Boot provides the A/B slot selection (boot-ab.cmd boot script).
WENDYOS_RPI_UBOOT ?= "1"
RPI_USE_U_BOOT = "${@'1' if d.getVar('WENDYOS_RPI_UBOOT') == '1' else '0'}"

# No UEFI capsule on RPi (the A/B swap covers the rootfs; RPi firmware blobs
# ride in the boot FAT).
WENDYOS_UPDATE_BOOTLOADER ?= "0"
WENDYOS_EFI_DEBUG ?= "0"
WENDYOS_DEEPSTREAM ?= "0"
# Persistent journal can be turned on once /data is verified to be mounted
# correctly; default off for now to preserve existing behavior.
WENDYOS_PERSIST_JOURNAL_LOGS ?= "0"
WENDYOS_MDNS_INTERFACES ?= ""
WENDYOS_DEBUG ?= "0"

# Driver add-ons (systemd-sysext) are an RPi feature for now; enable here so the
# distro-wide default stays "0" and Jetson/QEMU images are untouched.
WENDYOS_DRIVER_EXTENSIONS ?= "1"

# RPi boot config (consumed by rpi-config_%.bbappend)
ENABLE_UART = "1"
ENABLE_DWC2_PERIPHERAL = "${@oe.utils.ifelse(d.getVar('WENDYOS_USB_GADGET') == '1', '1', '0')}"
DISABLE_RPI_BOOT_LOGO = "1"
DISABLE_SPLASH = "1"
DISABLE_OVERSCAN = "1"

SERIAL_CONSOLES_CHECK = ""
EXTRADEPS = ""
```

## conf/machine/jetson-agx-orin-devkit-emmc-wendyos.conf
```bitbake
# jetson-agx-orin-devkit-emmc-wendyos.conf
# eMMC boot configuration for Jetson AGX Orin DevKit (P3701-0005, 64GB module).
#
# This variant boots and writes WendyOS to the onboard 64GB eMMC instead of
# an external NVMe SSD. Flashing this image WILL OVERWRITE the factory NVIDIA
# JetPack image that ships on the eMMC of a new DevKit.

MACHINEOVERRIDES =. "jetson-agx-orin-devkit:"

# Inherit from upstream 64GB AGX Orin config (P3701-0005, SKU 0005)
# This sets TEGRA_BOARDSKU, KERNEL_DEVICETREE, BPMP DTB, PMIC, and SDRAM configs
# for the 64GB module variant
require conf/machine/p3737-0000-p3701-0005.conf

# Use NVIDIA prebuilt UEFI firmware for AGX Orin.
# Source-built edk2-firmware-tegra causes a boot loop on this platform.
# See docs/agx-orin-edk2-boot-loop.md for symptom details, pinned versions
# at the time the workaround was required, and the re-test checklist.
# (The same SoC and firmware path are used regardless of NVMe vs eMMC boot.)
PREFERRED_PROVIDER_virtual/bootloader = "tegra-uefi-prebuilt"

# AB upgrades & bootloader choices (board-specific)
UBOOT_EXTLINUX = "1"
USE_REDUNDANT_FLASH_LAYOUT_DEFAULT = "1"

# UEFI Capsule Update Configuration
# Disable Secure Boot for development/testing (no signing keys configured)
# When "false": No key enrollment, Secure Boot disabled, unsigned capsules accepted
# Set to "true" for production after implementing proper signing infrastructure
TEGRA_UEFI_USE_SIGNED_FILES = "false"

# eMMC storage: 64GB module (P3701-0005), ~59.28 GiB usable after vendor
# reserve — the 2 x 12 GiB A/B layout fits with ample headroom for the
# config + data partitions.

# IMPORTANT: Use partition 17 for the data partition, NOT partition 15 (UDA)
# UDA (p15) is reserved by NVIDIA and positioned before rootfs partitions,
# preventing expansion. Partition 17 (data) is positioned AFTER APP_b and
# can expand to fill remaining disk space.
# tegra_partition_config.bbclass (lines 310-319) iterates over ['sdcard',
# 'sdmmc_user'] device types in the template XML, so the eMMC layout is
# normalised to the same on-disk GPT (config p16 + data p17) as NVMe.

# BUP (Bootloader Update Payload) must not reference data partition images.
# For sdmmc_user-based machines the config and mender_data partitions live in
# the same XML that BUP processes, so without this strip BUP fails at payload
# generation looking for config-partition.fat32.img. Same pattern as the
# Nano-SD variant; not needed on NVMe variants where these partitions are in
# the EXTERNAL XML which BUP does not read.
TEGRA_BUPGEN_STRIP_IMG_NAMES:append = " config-partition.fat32.img"

# eMMC boot device configuration (mmcblk0 = onboard eMMC on AGX; mmcblk1 = SD slot).
TNSPEC_BOOTDEV = "mmcblk0p1"

# Partition layout: QSPI for the boot chain + eMMC user area for rootfs A/B.
# This matches agx-orin.inc's upstream default and contrasts with the NVMe
# variant which uses flash_t234_qspi.xml + flash_l4t_t234_nvme.xml.
#
# Do NOT set PARTITION_LAYOUT_TEMPLATE_DEFAULT_SUPPORTS_REDUNDANT here. The
# bare flash_t234_qspi_sdmmc.xml in the BSP tarball has only APP (no APP_b),
# so we must let tegra-common.inc:140 auto-substitute to the
# flash_t234_qspi_sdmmc_rootfs_ab.xml variant which has both APP and APP_b.
# The WendyOS bbclass (tegra_partition_config.bbclass:312) then adds config
# (p16) and data (p17) on top of the A/B template.
PARTITION_LAYOUT_TEMPLATE_DEFAULT = "flash_t234_qspi_sdmmc.xml"

# Suppress NVMe external XML processing for this internal-eMMC machine.
# tegra234.inc inherits PARTITION_LAYOUT_EXTERNAL_DEFAULT = "flash_l4t_t234_nvme.xml";
# the empty override stops tegra-storage-layout from generating an unused
# external-flash.xml and prevents accidental "doexternal.sh against NVMe"
# usage with an eMMC-targeted image.
PARTITION_LAYOUT_EXTERNAL_DEFAULT = ""

# wendyos-update OTA (blacksail/JP7.2): a single flashable tegraflash-tar
# (the r38+ IMAGE_TYPE rename, as on Thor).
IMAGE_FSTYPES:tegra = "tegraflash-tar"

# blacksail oe-core defaults IMAGE_NAME_SUFFIX to ".rootfs", which would push
# ".rootfs" into deployed artifact/symlink names; the publisher + CI expect
# none.
IMAGE_NAME_SUFFIX = ""
IMAGE_FSTYPES:pn-tegra-minimal-initramfs:tegra = "${INITRAMFS_FSTYPES}"
IMAGE_FSTYPES:pn-tegra-initrd-flash-initramfs:tegra = "${TEGRA_INITRD_FLASH_INITRAMFS_FSTYPES}"

# 64GB eMMC capacity in bytes (P3701-0005). Upstream agx-orin.inc:7 defaults to
# 31276924928 (32GB module value) and p3737-0000-p3701-0005.conf does not
# override it, so we must set it here. Value sourced from
# repos/meta-tegra/conf/machine/jetson-agx-orin-devkit-industrial.conf:9
# (P3701-0008, the Industrial 64GB SKU which uses the same eMMC class).
EMMC_SIZE = "63652757504"

# Size each A/B APP slot to exactly the fixed 12 GiB rootfs image
# (conf/distro/include/wendyos-rootfs-size.inc): the redundant layout halves
# ROOTFSPART_SIZE_DEFAULT per slot and image_types_tegra.bbclass substitutes
# it for APPSIZE in the layout XML, so slot == image == .wendy OTA payload
# (docs/plans/fixed-rootfs-sizes.md). Replaces the upstream meta-tegra
# default; the reclaimed space goes to the data partition, grown to 100%
# on first boot.
ROOTFSPART_SIZE_DEFAULT = "25769803776"

# Stable board identity written to /etc/wendyos/device-type
WENDYOS_BOARD_ID = "jetson-agx-orin-emmc"
```

## conf/machine/jetson-agx-thor-devkit-nvme-wendyos.conf
```bitbake
# jetson-agx-thor-devkit-nvme-wendyos.conf
# NVMe boot configuration for Jetson AGX Thor DevKit (P3834-0008 module on
# P4071-0000 carrier). Tegra264 / SOC_FAMILY = "tegra264", JetPack 7.1 /
# L4T 38.4.0. Runs the wendyos-update OTA stack.
MACHINEOVERRIDES =. "jetson-agx-thor-devkit:"

# Inherit from upstream meta-tegra Thor DevKit machine config
# (P3834-0008 module on P4071-0000 carrier). Pulls in
# conf/machine/include/tegra264.inc which sets SOC_FAMILY = "tegra264",
# console = ttyUTC0 @ 115200, T264 boot firmware list, hafnium provider,
# and TEGRA_EDK2_PLATFORM = "t26x".
require conf/machine/jetson-agx-thor-devkit.conf

# Use NVIDIA prebuilt UEFI firmware (defensive, mirrors AGX Orin practice).
# The source-built edk2-firmware-tegra recipe
# for T264 has not been validated end-to-end on Thor yet.
PREFERRED_PROVIDER_virtual/bootloader = "tegra-uefi-prebuilt"

# Bootloader choice: extlinux (matches Orin family).
UBOOT_EXTLINUX = "1"

# Rootfs A/B redundancy via upstream meta-tegra machinery
# (conf/machine/include/tegra-common.inc on r38):
#   - pulls L4TConfiguration-RootfsRedundancyLevelABEnable.dtbo into
#     TEGRA_BOOTCONTROL_OVERLAYS,
#   - switches PARTITION_LAYOUT_EXTERNAL to the auto-derived
#     flash_l4t_t264_nvme_rootfs_ab.xml,
#   - halves ROOTFSPART_SIZE for the two slots.
# Whether the r38 BSP ships the t264 _rootfs_ab.xml, and whether GPT ids
# 16/17 are free for config/wendy_data in the t264 layout, is verified at
# first build (wendy-ota-update.md Phase 1).
USE_REDUNDANT_FLASH_LAYOUT_DEFAULT = "1"

# UEFI Capsule Update Configuration
# Disable Secure Boot for development/testing (no signing keys configured).
# Set to "true" for production after implementing proper signing
# infrastructure.
TEGRA_UEFI_USE_SIGNED_FILES = "false"

# wrynose oe-core (image-artifact-names.bbclass) defaults IMAGE_NAME_SUFFIX to
# ".rootfs", which would make IMAGE_LINK_NAME include ".rootfs" and produce
# deployed symlinks like wendyos-image-${MACHINE}.rootfs.tegraflash-tar.
# The publisher and CI scripts expect no suffix, matching scarthgap behaviour.
IMAGE_NAME_SUFFIX = ""

# Image formats: produces a one-shot flashable image only.
# The data partition is allocated empty at flash time and formatted on
# first boot; the .wendy OTA artifact is added by wendyos-update.inc.
# On r38.4.x the IMAGE_TYPE was renamed: tegraflash → tegraflash-tar
# (verified via OE4T/meta-tegra master-l4t-r38.4.x:
#   classes-recipe/image_types_tegra.bbclass:7  IMAGE_TYPES += "tegraflash-tar"
#   conf/machine/include/tegra-common.inc:68    IMAGE_FSTYPES += "tegraflash-tar.zst"
# ).
IMAGE_FSTYPES:tegra = "tegraflash-tar"
IMAGE_FSTYPES:pn-tegra-minimal-initramfs:tegra = "${INITRAMFS_FSTYPES}"
IMAGE_FSTYPES:pn-tegra-initrd-flash-initramfs:tegra = "${TEGRA_INITRD_FLASH_INITRAMFS_FSTYPES}"

# Rootfs sizing: pinned to a fixed 12 GiB by
# conf/distro/include/wendyos-rootfs-size.inc (required via the wendy OTA
# stack) — image, A/B slot, and .wendy OTA payload are all exactly that size,
# and nightly/release builds are byte-identical in size by construction
# (docs/plans/fixed-rootfs-sizes.md).

# Size each A/B APP slot to exactly the fixed rootfs image size. The
# auto-derived redundant layout (flash_l4t_t264_nvme_rootfs_ab.xml) gives both
# APP partitions <size> APPSIZE </size>, image_types_tegra.bbclass substitutes
# APPSIZE = ROOTFSPART_SIZE, and tegra-common.inc halves ROOTFSPART_SIZE_DEFAULT
# for the two slots when the redundant layout is on. Upstream defaults this to
# 50 GiB (25 GiB per slot) in jetson-agx-thor-devkit.conf; pin it to 2 x 12 GiB
# so slot == image == OTA payload. The reclaimed NVMe space goes to the data
# partition, which wendyos-data-init grows to 100% on first boot.
ROOTFSPART_SIZE_DEFAULT = "25769803776"

# Keep the rootfs ext4 a 128 MiB (== 32768 4K-block) multiple so
# blocks_per_group is always 32768. NVIDIA's UEFI ext4 reader (EDK2 Ext4Pkg
# Ext4Dxe, Superblock.c) rejects any filesystem with blocks_per_group !=
# 8*blocksize (32768 for 4K blocks) with EFI_UNSUPPORTED, so L4TLauncher then
# cannot read /boot/extlinux/extlinux.conf and the board boot-loops. mke2fs
# shrinks blocks_per_group when the final group would be a runt (e.g. to
# 32736) even if "-g 32768" is passed; a 128 MiB-multiple size leaves a full
# final group. The pinned 12 GiB is itself a 128 MiB multiple, so this
# alignment is a no-op today — it stays as a guard should the pinned size
# ever change to a non-multiple.
# Scoped to pn-wendyos-image only: a machine-wide alignment also rounds the ESP
# image (tegra-espimage) up past its 64 MiB IMAGE_ROOTFS_MAXSIZE and fails the
# build. IMAGE_ROOTFS_ALIGNMENT (KiB) also feeds TEGRA_BLBLOCKSIZE, so pin the
# latter (for this image) to its current 4 KiB value so mksparse / the flash
# helper are unchanged.
IMAGE_ROOTFS_ALIGNMENT:pn-wendyos-image = "131072"
TEGRA_BLBLOCKSIZE:pn-wendyos-image = "4096"

# Stable board identity written to /etc/wendyos/device-type
WENDYOS_BOARD_ID = "jetson-agx-thor"
```

## conf/machine/jetson-orin-nano-devkit-nvme-wendyos.conf
```bitbake
# jetson-orin-nano-devkit-nvme-wendyos.conf
# NVMe boot configuration for Jetson Orin Nano DevKit

MACHINEOVERRIDES =. "jetson-orin-nano-devkit:"

# include upstream base if available
require conf/machine/jetson-orin-nano-devkit-nvme.conf

# AB upgrades & bootloader choices (board-specific)
UBOOT_EXTLINUX = "1"
USE_REDUNDANT_FLASH_LAYOUT_DEFAULT = "1"

# UEFI Capsule Update Configuration
# Disable Secure Boot for development/testing (no signing keys configured)
# When "false": No key enrollment, Secure Boot disabled, unsigned capsules accepted
# Set to "true" for production after implementing proper signing infrastructure
TEGRA_UEFI_USE_SIGNED_FILES = "false"

# The persistent data partition (id 17, after APP_b) is inserted by
# tegra_partition_config.bbclass — allocated empty at flash time, formatted
# and grown to 100% on first boot by wendyos-data-setup. UDA (p15) is NOT
# used: it is reserved by NVIDIA and positioned before the rootfs
# partitions, preventing expansion.

# NVMe boot device configuration
TNSPEC_BOOTDEV = "nvme0n1p1"

# Use NVMe partition layout
PARTITION_LAYOUT_TEMPLATE_DEFAULT = "flash_t234_qspi.xml"
PARTITION_LAYOUT_TEMPLATE_DEFAULT_SUPPORTS_REDUNDANT = "1"
PARTITION_LAYOUT_EXTERNAL_DEFAULT = "flash_l4t_t234_nvme.xml"

# wendyos-update OTA (blacksail/JP7.2): a single flashable tegraflash-tar
# (the r38+ IMAGE_TYPE rename, as on Thor).
IMAGE_FSTYPES:tegra = "tegraflash-tar"

# blacksail oe-core defaults IMAGE_NAME_SUFFIX to ".rootfs", which would push
# ".rootfs" into deployed artifact/symlink names; the publisher + CI expect
# none.
IMAGE_NAME_SUFFIX = ""
IMAGE_FSTYPES:pn-tegra-minimal-initramfs:tegra = "${INITRAMFS_FSTYPES}"
IMAGE_FSTYPES:pn-tegra-initrd-flash-initramfs:tegra = "${TEGRA_INITRD_FLASH_INITRAMFS_FSTYPES}"

# If you really need it, board param (but consider removing if unused):
EMMC_SIZE = "0"

# Size each A/B APP slot to exactly the fixed 12 GiB rootfs image
# (conf/distro/include/wendyos-rootfs-size.inc): the redundant layout halves
# ROOTFSPART_SIZE_DEFAULT per slot and image_types_tegra.bbclass substitutes
# it for APPSIZE in the layout XML, so slot == image == .wendy OTA payload
# (docs/plans/fixed-rootfs-sizes.md). Replaces the upstream meta-tegra
# default; the reclaimed space goes to the data partition, grown to 100%
# on first boot.
ROOTFSPART_SIZE_DEFAULT = "25769803776"

# Stable board identity written to /etc/wendyos/device-type
WENDYOS_BOARD_ID = "jetson-orin-nano"
```
