## conf/distro/include/flash-image-sizes.inc
```bitbake
# Flash Image Size Configurations for WendyOS
#
# This file defines custom partition sizes for Tegra flash images.
# Device size is set by TEGRA_EXTERNAL_DEVICE_SECTORS; the A/B rootfs (APP)
# slot size is set by MENDER_STORAGE_TOTAL_SIZE_MB (see below — NOT
# ROOTFSPART_SIZE_DEFAULT, which Mender's tegra-mender-setup overrides).
#
# Usage: Set WENDYOS_FLASH_IMAGE_SIZE in local.conf or distro config
#        Values: "4GB", "8GB", "16GB", "32GB", "64GB" (default: "8GB")

WENDYOS_FLASH_IMAGE_SIZE ??= "8GB"

# Total sectors for different image sizes (sector size = 512 bytes)
# Formula: (SIZE_IN_GB * 1000 * 1000 * 1000) / 512
TEGRA_EXTERNAL_DEVICE_SECTORS:4GB = "7812500"
TEGRA_EXTERNAL_DEVICE_SECTORS:8GB = "15625000"
TEGRA_EXTERNAL_DEVICE_SECTORS:16GB = "31250000"
TEGRA_EXTERNAL_DEVICE_SECTORS:32GB = "62500000"
TEGRA_EXTERNAL_DEVICE_SECTORS:64GB = "125000000"

# Override based on WENDYOS_FLASH_IMAGE_SIZE
TEGRA_EXTERNAL_DEVICE_SECTORS = "${TEGRA_EXTERNAL_DEVICE_SECTORS:${WENDYOS_FLASH_IMAGE_SIZE}}"

# Storage budget (in MiB — Mender multiplies by 1048576) that the A/B rootfs
# slots are carved from. Mender sizes EACH slot as
#   (MENDER_STORAGE_TOTAL_SIZE_MB - MENDER_DATA_PART_SIZE_MB[512]) / 2,
# so THIS value — not the device size (TEGRA_EXTERNAL_DEVICE_SECTORS above) —
# sets the per-slot rootfs size; leftover device space flows to the
# auto-growing /data. The rootfs partition size is frozen at flash and CANNOT
# be changed by an OTA, so it must be right here.
#
#   per-slot MiB = (value - 512) / 2
#   64GB -> 25088 => 12288 MiB = 12.0 GiB/slot   (Jetson target)
#           alt 33280 => 16.0 GiB/slot; old 51000 => 24.65 GiB/slot (oversized)
#   4/8/16/32GB buckets keep their historical fill-the-device values.
MENDER_STORAGE_TOTAL_SIZE_MB = "${@{'4GB': '3200', '8GB': '6400', '16GB': '12800', '32GB': '25700', '64GB': '25088'}.get(d.getVar('WENDYOS_FLASH_IMAGE_SIZE'), '6400')}"
```

## conf/distro/include/journal-logs-modern.inc
```bitbake
# Modern (post-scarthgap) path for /var/log placement: trim
# files/fs-perms-volatile-log.txt out of the default FILESYSTEM_PERMS_TABLES
# when /var/log should be persistent. The oe-core default (whinlatter and
# later) is "files/fs-perms.txt files/fs-perms-volatile-log.txt
# files/fs-perms-volatile-tmp.txt". Removing the volatile-log entry makes
# /var/log persistent (on rootfs); leaving it makes /var/log volatile
# (tmpfs). /tmp stays volatile in both cases. Scarthgap uses the legacy
# VOLATILE_LOG_DIR — see journal-logs-scarthgap.inc.
#
# WENDYOS_PERSIST_JOURNAL_LOGS = "1" → /var/log is persistent.
# WENDYOS_PERSIST_JOURNAL_LOGS = "0" → /var/log is volatile (default).
FILESYSTEM_PERMS_TABLES:remove = "${@'files/fs-perms-volatile-log.txt' if d.getVar('WENDYOS_PERSIST_JOURNAL_LOGS') == '1' else ''}"
```

## conf/distro/include/journal-logs-scarthgap.inc
```bitbake
# Scarthgap path for /var/log placement: legacy VOLATILE_LOG_DIR.
# Whinlatter and later use FILESYSTEM_PERMS_TABLES instead — see the
# sibling journal-logs-modern.inc and the gating require in wendyos.conf.
#
# WENDYOS_PERSIST_JOURNAL_LOGS = "1" → /var/log is persistent (on rootfs).
# WENDYOS_PERSIST_JOURNAL_LOGS = "0" → /var/log is volatile (tmpfs).
VOLATILE_LOG_DIR = "${@'no' if d.getVar('WENDYOS_PERSIST_JOURNAL_LOGS') == '1' else 'yes'}"
```

## conf/distro/include/l4t-r38-4-0.conf
```bitbake
#
# L4T R38.4.0 Version Pinning Configuration
# This file pins all NVIDIA L4T packages to release 38.4.0 (JetPack 7.1)
# for Thor (tegra264 / SOC_FAMILY = "tegra264").
#
# Versions below were transcribed from meta-tegra branch master-l4t-r38.4.x
# at SRCREV 1f28e68deca6773059da8635f0353aff23340790. Where a value
# could not be confirmed against an upstream recipe filename, it is left
# as a clearly-flagged TODO rather than guessed.

# L4T version string (format: major.minor.patch)
L4T_VERSION = "38.4.0"

# Corresponding BSP version used by meta-tegra
L4T_BSP_VERSION = "r38.4.0"

# CUDA version for L4T 38.4 (JetPack 7.1 ships CUDA 13.0)
# Source: meta-tegra master-l4t-r38.4.x conf/machine/include/tegra-common.inc
#         CUDA_VERSION ?= "13.0"
CUDA_VERSION = "13.0"
CUDA_VERSION_DASHED = "13-0"

# cuDNN version for this release
# Source: recipes-devtools/cudnn/cudnn_9.12.0.46-1.bb
CUDNN_VERSION = "9.12.0"

# TensorRT version for this release
# Source: recipes-devtools/gie/tensorrt-core_10.13.3.9-1.bb
TENSORRT_VERSION = "10.13.3"

# Pin specific L4T packages to r38.4.0
PREFERRED_VERSION_tegra-libraries = "38.4.0%"
PREFERRED_VERSION_tegra-libraries-multimedia = "38.4.0%"
PREFERRED_VERSION_tegra-libraries-cuda = "38.4.0%"
PREFERRED_VERSION_tegra-libraries-nvsci = "38.4.0%"

# CUDA toolkit pinning
PREFERRED_VERSION_cuda-toolkit = "13.0%"
PREFERRED_VERSION_cuda-cudart = "13.0%"
PREFERRED_VERSION_cuda-nvcc = "13.0%"

# cuDNN pinning
PREFERRED_VERSION_cudnn = "9.12%"

# TensorRT pinning
PREFERRED_VERSION_tensorrt-core = "10.13%"
# Source: master-l4t-r38.4.x conf/machine/include/tegra-common.inc
#         PREFERRED_PROVIDER_tensorrt-plugins ?= "tensorrt-plugins-prebuilt"
# Recipe: recipes-devtools/gie/tensorrt-plugins-prebuilt_10.13.3.9-1.bb
PREFERRED_VERSION_tensorrt-plugins-prebuilt = "10.13%"

# NVIDIA container runtime
# Source: external/virtualization-layer/recipes-containers/libnvidia-container/libnvidia-container_1.18.0.bb
# Source: external/virtualization-layer/recipes-containers/nvidia-container-toolkit/nvidia-container-toolkit_1.18.0.bb
PREFERRED_VERSION_libnvidia-container = "1.18%"
PREFERRED_VERSION_nvidia-container-toolkit = "1.18%"

# Optional: Force specific git SHAs if needed for reproducibility
# L4T_BSP_SHA256 = "your-sha-here"
# L4T_KERNEL_SHA256 = "your-sha-here"

# Prevent automatic updates
# This ensures builds are reproducible and don't fetch newer versions
TEGRA_SKIP_VERSION_CHECK = "1"
```

## conf/distro/include/mender.inc
```bitbake
# Image outputs: disk + OTA artifact
# IMAGE_FSTYPES += "uefiimg mender ext4"

INHERIT += "mender-full"

# Enable automatic data partition growth on first boot
# This allows the data partition to expand to use all available disk space
MENDER_FEATURES_ENABLE:append = " mender-growfs-data"

# Mender artifact naming and daemon polling intervals.
# Reproducible artifact name across rebuilds — DATETIME would force a new
# artifact every build. ${IMAGE_BASENAME} / ${IMAGE_VERSION_SUFFIX} are
# recipe-time variables; BB lazy expansion resolves them when the image
# recipe is parsed.
MENDER_ARTIFACT_NAME = "${IMAGE_BASENAME}-${MACHINE}-${IMAGE_VERSION_SUFFIX}"
# MENDER_ARTIFACT_NAME = "${IMAGE_BASENAME}-${DISTRO_VERSION}-${DATETIME}"

MENDER_UPDATE_POLL_INTERVAL_SECONDS    = "1800"
MENDER_INVENTORY_POLL_INTERVAL_SECONDS = "28800"
MENDER_RETRY_POLL_INTERVAL_SECONDS     = "300"
MENDER_SYSTEMD_AUTO_ENABLE = "1"
MENDER_CONNECT_ENABLE = "1"

# tegra-support-sanity and distro_layer_buildinfo only work as intended
# when inherited in the OE4t setup-env.sh-style environment (they modify
# bblayers.conf and expect host info we don't provide). Removing them is
# a no-op on machines that don't inherit them, so this is safe to apply
# universally. tegra-mender-setup is Tegra-specific and lives in
# conf/distro/include/tegra-image.inc.
INHERIT:remove = "tegra-support-sanity distro_layer_buildinfo"
```

## conf/distro/include/rpi-image.inc
```bitbake
# RPi-specific image configuration
# This file is included when building for RPi machines (MACHINEOVERRIDES contains 'rpi')

inherit partuuid-rpi

# RPi-specific packages
IMAGE_INSTALL:append = " \
    packagegroup-wendyos-rpi \
    "

# Remove Tegra-only packages added by tegra-image.inc or wendyos-image.bb.
# Layer separation removes these recipes from the parse tree, but IMAGE_INSTALL
# is resolved at task-scheduling time — absent packages must be explicitly removed.
IMAGE_INSTALL:remove = " \
    tegra-bootcontrol-overlay \
    packagegroup-wendyos-tegra \
    packagegroup-nvidia-container \
    nvidia-container-config \
    setup-nv-boot-control \
    usb-gadget-modules \
    usb-network-tuning \
    e2fsprogs-mke2fs \
    util-linux-mount \
    "

# WIC build dependencies
do_image_wic[depends] += " \
    rpi-cmdline:do_deploy \
    wic-tools:do_populate_sysroot \
    e2fsprogs-native:do_populate_sysroot \
    gptfdisk-native:do_populate_sysroot \
    "

do_image_wic[depends] += "${PN}:do_generate_partuuids"
WIC_CREATE_EXTRA_ARGS ?= "--no-fstab-update"

# Create the /config and /data mount point directories (fstab entries are in
# rpi-fstab / rpi-wendy-fstab). The rootfs is read-only at runtime (A/B slot), so
# systemd cannot mkdir a missing mount point -- data.mount then fails on a clean
# fs and the /data bind mounts + Wendy Agent cascade-fail. wendyos-data-setup is
# dropped on RPi (see below), so /data must be created here.
create_rpi_mountpoints() {
    mkdir -p ${IMAGE_ROOTFS}/config
    mkdir -p ${IMAGE_ROOTFS}/data

    # Bind-mount targets for the persistent /data volumes (var-lib-wendy.mount,
    # var-lib-containerd.mount: /data/wendy -> /var/lib/wendy, /data/containerd ->
    # /var/lib/containerd). Those units use x-systemd.mkdir, but it only creates
    # the target on a WRITABLE fs; on the read-only A/B rootfs (and with the
    # volatile /var/lib bind skipped on blacksail systemd 259) it can't, so the
    # bind mounts fail and wendyos-agent/containerd never start. Pre-create the
    # targets so the binds succeed regardless of /var/lib writability. (Bind
    # mounts overlay these empty dirs with the /data sources.)
    mkdir -p ${IMAGE_ROOTFS}/var/lib/wendy
    mkdir -p ${IMAGE_ROOTFS}/var/lib/containerd
}

ROOTFS_POSTPROCESS_COMMAND:append = " create_rpi_mountpoints;"

# --- wendyos-update (wendy) image deltas for RPi --------------------------
# 1) Drop wendyos-data-setup (pulled by wendyos-update.inc): on RPi the /data
#    first-boot grow is done by grow-data-part (in packagegroup-wendyos-rpi).
#    wendyos-data-init only (re)formats a missing/oversized fs, so it would skip
#    the wic-preformatted ext4 data partition.
IMAGE_INSTALL:remove = "wendyos-data-setup"

# 2) wendy-stack RPi extras:
#    - wendyos-fw-env       /etc/fw_env.config so the ubootenv connector's
#                           fw_setenv reaches uboot.env on the boot FAT.
#    - wendyos-update-config pins the connector to "ubootenv".
#    - kernel-image          the boot script ext4loads /boot/${KERNEL_IMAGETYPE}
#                            from the selected rootfs slot (A/B-safe); meta-
#                            raspberrypi only deploys the kernel to the FAT.
IMAGE_INSTALL:append = " wendyos-fw-env wendyos-update-config kernel-image"

# 3) Fixed A/B rootfs sizing — the image, the A/B slot, and the .wendy OTA
#    payload are all pinned to one per-platform constant so they are identical
#    on every build and an OTA image can never outgrow its on-device slot. The
#    mechanism (floor==ceiling IMAGE_ROOTFS_SIZE/MAXSIZE + pack-time guard) lives
#    in conf/distro/include/wendyos-rootfs-size.inc (required via
#    wendyos-update.inc; WENDYOS_ROOTFS_SIZE_KB:rpi = 8 GiB), with the matching
#    `--fixed-size ${WENDYOS_ROOTFS_SIZE_KB}K` rootfsA/rootfsB slots in rpi-wendy-ab*.wks.
```

## conf/distro/include/systemd-features-modern.inc
```bitbake
# Modern (post-scarthgap) path: DISTRO_FEATURES_BACKFILL_CONSIDERED was
# renamed to DISTRO_FEATURES_OPTED_OUT in wrynose oe-core. Setting the
# old name on wrynose errors via BB_RENAMED_VARIABLES; scarthgap doesn't
# know about the new name. Series-gated from systemd.conf.
DISTRO_FEATURES_OPTED_OUT += " sysvinit"
```

## conf/distro/include/systemd-features-scarthgap.inc
```bitbake
# Scarthgap path: prevent sysvinit from being backfilled into
# DISTRO_FEATURES via the legacy DISTRO_FEATURES_BACKFILL_CONSIDERED
# variable. Wrynose renamed this to DISTRO_FEATURES_OPTED_OUT — see
# systemd-features-modern.inc and the gating require in systemd.conf.
DISTRO_FEATURES_BACKFILL_CONSIDERED += " sysvinit"
```

## conf/distro/include/tegra-overlays.inc
```bitbake
# WendyOS Tegra boot-control DT overlays -- the single definition of what gets
# merged into the boot-chain firmware DTB.
#
# This file MUST be required by EVERY recipe that packages boot-chain firmware
# from TEGRA_BOOTCONTROL_OVERLAYS, currently:
#   - wendyos-image (via conf/distro/include/tegra-image.inc): the flash package
#   - tegra-uefi-capsules (via its bbappend in meta-tegra-extensions): the UEFI
#     capsule payload
# If one of them sees a different list, flashed firmware and capsule-updated
# firmware diverge: an overlay-less capsule erased the fTPM DT node from
# boot-chain B and left the encrypted /data locked (Thor). The other
# readers of the variable (edk2-firmware-tegra, tegra-uefi-prebuilt) only loop
# to deploy files they built themselves and skip unknown names, so they do not
# need this file. Require it exactly once per recipe.

# UEFI boot-priority overlay (NVMe first on NVMe machines).
TEGRA_BOOTCONTROL_OVERLAYS:append = " boot-priority.dtbo"

# fTPM device-tree overlay (opt-in via WENDYOS_ENABLE_TPM). NVIDIA ships the
# firmware/ftpm node status="disabled"; tegra-ftpm-overlay re-emits it "okay" so
# tpm_ftpm_tee binds and /dev/tpmrm0 appears. Only tegra264 (Thor) is validated;
# Orin needs its own overlay + OPTEE_ENABLE_FTPM:tegra234="1" (an OP-TEE rebuild)
# -- map WENDYOS_FTPM_DTBO:tegra234 once validated.
WENDYOS_FTPM_DTBO = ""
WENDYOS_FTPM_DTBO:tegra264 = "tegra264-ftpm.dtbo"
TEGRA_BOOTCONTROL_OVERLAYS:append = "${@(' ' + d.getVar('WENDYOS_FTPM_DTBO')) if d.getVar('WENDYOS_ENABLE_TPM') == '1' and d.getVar('WENDYOS_FTPM_DTBO') else ''}"
```

## conf/distro/include/unpackdir-scarthgap.inc
```bitbake
# Scarthgap predates the UNPACKDIR / WORKDIR split (introduced in
# styhead). Our recipes use ${UNPACKDIR} for SRC_URI-unpacked file paths
# so the same source tree builds on whinlatter (where UNPACKDIR is
# distinct: ${WORKDIR}/sources) and on scarthgap (where it is undefined
# without this shim). Alias UNPACKDIR to WORKDIR — matches the legacy
# fetcher behavior on scarthgap, so ${UNPACKDIR}/<file> resolves to the
# same directory the file is unpacked into.
UNPACKDIR = "${WORKDIR}"
```
